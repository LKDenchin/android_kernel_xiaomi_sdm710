## arch/arm64/configs/grus-defconfig
```kconfig
# Localversion
CONFIG_LOCALVERSION="-LKGeek-perf"
# CONFIG_LOCALVERSION_AUTO is not set

# DEBUG
CONFIG_DEBUG_INFO=n
# CONFIG_SLUB_CPU_PARTIAL is not set

# FRAME WARN
CONFIG_FRAME_WARN=0

# DTBO
CONFIG_BUILD_ARM64_DT_OVERLAY=y

# exFAT
CONFIG_EXFAT_FS=y

# Haptics
CONFIG_LEDS_QPNP_HAPTICS=n
CONFIG_INPUT_QTI_HAPTICS=y

# initramfs
CONFIG_INITRAMFS_IGNORE_SKIP_FLAG=y

# IR
CONFIG_MEDIA_RC_SUPPORT=y
CONFIG_LIRC=y
CONFIG_RC_DEVICES=y
CONFIG_IR_SPI=y

# LKMD (Low-Memory-Killer-Daemon) dependencies
# CONFIG_ANDROID_LOW_MEMORY_KILLER is not set
CONFIG_PSI=y

# pstore
CONFIG_CMDLINE="cgroup_disable=pressure ramoops_memreserve=4M"
CONFIG_CMDLINE_EXTEND=y
CONFIG_PSTORE=y
CONFIG_PSTORE_CONSOLE=y
CONFIG_PSTORE_PMSG=y
CONFIG_PSTORE_RAM=y
CONFIG_BLK_WBT=y
CONFIG_BLK_WBT_SQ=y
CONFIG_MTD=y
CONFIG_MTD_BLOCK=y
CONFIG_MTD_OOPS=y
CONFIG_MTD_BLOCK2MTD=y

# QCACLD
CONFIG_QCA_CLD_WLAN=y

# USB ConfigFS
CONFIG_USB_CONFIGFS_F_UVC=y

# vDSO
CONFIG_COMPAT_VDSO=y

# CONFIG_CPU_FREQ_TIMES is not set

# Zram
CONFIG_CRYPTO_LZ4=y

CONFIG_KSU=y
CONFIG_ANDROID_SPOOF_KERNEL_VERSION_FOR_BPF=y

# Hypercore

CONFIG_LIRC=y
CONFIG_RC_CORE=y
CONFIG_RC_DECODERS=y
CONFIG_RC_DEVICES=y

CONFIG_EROFS_FS=y
CONFIG_EROFS_FS_PCPU_KTHREAD=y
CONFIG_EROFS_FS_PCPU_KTHREAD_HIPRI=y
CONFIG_TCP_CONG_ADVANCED=y
CONFIG_TCP_CONG_BIC=n
CONFIG_TCP_CONG_CUBIC=y
# CONFIG_TCP_CONG_WESTWOOD is not set
# CONFIG_TCP_CONG_ILLINOIS is not set
# CONFIG_TCP_CONG_DCTCP is not set
# CONFIG_TCP_CONG_CDG is not set
CONFIG_TCP_CONG_BBR=y
CONFIG_TCP_CONG_PIXIE=y
CONFIG_DEFAULT_BBR=m
CONFIG_DEFAULT_PIXIE=y
# CONFIG_DEFAULT_RENO is not set
CONFIG_DEFAULT_TCP_CONG="pixie"
# CONFIG_TCP_CONG_HSTCP is not set
# CONFIG_TCP_CONG_HYBLA is not set
CONFIG_TCP_CONG_HTCP=n
# CONFIG_KALLSYMS is not set

CONFIG_AUDIT=y
CONFIG_HAVE_ARCH_AUDITSYSCALL=y
CONFIG_AUDITSYSCALL=y
CONFIG_INTEGRITY_AUDIT=y
CONFIG_AUDIT_GENERIC=y
CONFIG_AUDIT_ARCH_COMPAT_GENERIC=y
CONFIG_AUDIT_COMPAT_GENERIC=y
```
